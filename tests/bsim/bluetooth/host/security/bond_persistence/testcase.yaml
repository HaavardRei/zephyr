## tests/bsim/bluetooth/host/security/bond_persistence/testcase.yaml
```yaml
tests:
  bluetooth.host.security.bond_persistence:
    build_only: true
    tags:
      - bluetooth
    platform_allow:
      - nrf52_bsim/native
    harness: bsim
    harness_config:
      bsim_exe_name: tests_bsim_bluetooth_host_security_bond_persistence_prj_conf
```
