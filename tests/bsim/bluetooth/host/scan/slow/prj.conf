## prj.conf
```kconfig
CONFIG_BT=y
CONFIG_BT_BROADCASTER=y
CONFIG_BT_CENTRAL=y
CONFIG_BT_OBSERVER=y
CONFIG_BT_EXT_ADV=y
CONFIG_BT_DEVICE_NAME="Scanner Test"
CONFIG_BT_TESTING=y

# Enable privacy with frequent address refreshes
CONFIG_BT_SMP=y
CONFIG_BT_PRIVACY=y
CONFIG_BT_RPA_TIMEOUT=2

# Enable chained advertising data so the peer can advertise ~1000 bytes,
# producing a fragmented chain at the scanner.
CONFIG_BT_CTLR_ADVANCED_FEATURES=y
CONFIG_BT_CTLR_ADV_DATA_CHAIN=y
CONFIG_BT_CTLR_ADV_DATA_LEN_MAX=1100
CONFIG_BT_CTLR_ADV_DATA_BUF_MAX=8
CONFIG_BT_CTLR_SCAN_DATA_LEN_MAX=1100
CONFIG_BT_CTLR_RX_BUFFERS=9
CONFIG_BT_BUF_EVT_RX_COUNT=16
CONFIG_BT_EXT_SCAN_BUF_SIZE=1100
CONFIG_BT_BUF_EVT_DISCARDABLE_SIZE=255

# Log & debug options
CONFIG_LOG=y
CONFIG_LOG_RUNTIME_FILTERING=y
CONFIG_LOG_THREAD_ID_PREFIX=y

CONFIG_ASSERT=y
CONFIG_THREAD_NAME=y
CONFIG_LOG_THREAD_ID_PREFIX=y
CONFIG_ARCH_POSIX_TRAP_ON_FATAL=y
```

## src/dut.c
```c
/* Copyright (c) 2024 Nordic Semiconductor ASA
 * SPDX-License-Identifier: Apache-2.0
 */

#include <zephyr/bluetooth/addr.h>
#include <zephyr/bluetooth/bluetooth.h>
#include <zephyr/bluetooth/testing.h>
#include <zephyr/kernel.h>
#include <zephyr/logging/log.h>
#include <zephyr/sys/atomic.h>
#include <zephyr/sys/atomic_builtin.h>

#include "testlib/log_utils.h"
#include "babblekit/flags.h"
#include "babblekit/testcase.h"

LOG_MODULE_REGISTER(dut, LOG_LEVEL_DBG);

extern unsigned long runtime_log_level;
extern bool use_chain_adv;

static atomic_t reassembly_timeout_count;
static atomic_t reassembly_complete_count;
static atomic_t reassembly_complete_after_timeout_count;

void bt_testing_trace_ext_adv_reassembly_timeout(void)
{
	atomic_inc(&reassembly_timeout_count);
}

void bt_testing_trace_ext_adv_reassembly_complete(void)
{
	atomic_inc(&reassembly_complete_count);

	if (atomic_get(&reassembly_timeout_count) > 0) {
		atomic_inc(&reassembly_complete_after_timeout_count);
	}
}

static void device_found(const bt_addr_le_t *addr, int8_t rssi, uint8_t type,
			 struct net_buf_simple *ad)
{
	char addr_str[BT_ADDR_LE_STR_LEN];

	k_msleep(500); /* simulate a slow memcpy (or user processing the scan data) */

	bt_addr_le_to_str(addr, addr_str, sizeof(addr_str));
	LOG_DBG("Device found: %s (RSSI %d), type %u, AD data len %u", addr_str, rssi, type,
		ad->len);
}

#define BT_LE_SCAN_ACTIVE_CONTINUOUS_WITH_DUPLICATES                                               \
	BT_LE_SCAN_PARAM(BT_LE_SCAN_TYPE_ACTIVE, 0, BT_GAP_SCAN_FAST_INTERVAL_MIN,                 \
			 BT_GAP_SCAN_FAST_WINDOW)

void entrypoint_dut(void)
{
	/* Test purpose:
	 *
	 * Verifies that the host can handle running out of HCI RX buffers.
	 *
	 * A scanner with privacy enabled sleeps in every advertising report
	 * callback, simulating slow processing on real hardware. This
	 * exhausts the event buffer pools.
	 *
	 * A short RPA timeout is used to prompt the host into periodically
	 * sending a bunch of commands to the controller. Those commands should
	 * not fail.
	 *
	 * There are two variants (selected via the "chain" argstest flag):
	 *   base  - peer sends default extended advertising data.
	 *   chain - peer sends ~1000 B across ~6 AUX_CHAIN_IND PDUs so
	 *           fragmented HCI ext adv reports (PARTIAL -> COMPLETE) are
	 *           produced. When buffers are exhausted the chain-aware
	 *           discard logic must drop entire chains and the host
	 *           reassembly timer must recover the slot.
	 *
	 * Note: The base test variant only fails by the stack crashing.
	 *
	 * The base variant is a regression test for
	 * https://github.com/zephyrproject-rtos/zephyr/issues/78223
	 *
	 * Two devices:
	 * - `dut`: active-scans with privacy ON
	 * - `peer`: extended advertiser
	 *
	 * [verdict]
	 * - dut is able to run for a long enough time without triggering asserts
	 */
	int err;

	TEST_START("DUT");

	/* Set the log level given by the `log_level` CLI argument */
	bt_testlib_log_level_set("dut", runtime_log_level);

	err = bt_enable(NULL);
	TEST_ASSERT(!err, "Bluetooth init failed (err %d)\n", err);

	LOG_DBG("Bluetooth initialised");

	err = bt_le_scan_start(BT_LE_SCAN_ACTIVE_CONTINUOUS_WITH_DUPLICATES, device_found);
	TEST_ASSERT(!err, "Scanner setup failed (err %d)\n", err);
	LOG_DBG("Explicit scanner started");

	/* 40 seconds ought to be enough for anyone */
	k_sleep(K_SECONDS(40));

	if (use_chain_adv) {
		int timeout_cnt = atomic_get(&reassembly_timeout_count);
		int complete_after_timeout_cnt =
			atomic_get(&reassembly_complete_after_timeout_count);
		int complete_cnt = atomic_get(&reassembly_complete_count);

		LOG_INF("Reassembly stats: timeout=%d complete=%d complete_after_timeout=%d",
			timeout_cnt, complete_cnt, complete_after_timeout_cnt);

		TEST_ASSERT(timeout_cnt > 0,
			    "Expected at least one ext adv reassembly timeout");
		TEST_ASSERT(complete_after_timeout_cnt > 0,
			    "Expected fragmented reports to recover after timeout");
	}

	TEST_PASS_AND_EXIT("DUT passed");
}
```

## src/peer.c
```c
/* Copyright (c) 2024 Nordic Semiconductor ASA
 * SPDX-License-Identifier: Apache-2.0
 */

#include <string.h>

#include <zephyr/bluetooth/addr.h>
#include <zephyr/bluetooth/bluetooth.h>
#include <zephyr/kernel.h>
#include <zephyr/logging/log.h>
#include <zephyr/sys/atomic.h>
#include <zephyr/sys/atomic_builtin.h>

#include "testlib/log_utils.h"
#include "babblekit/flags.h"
#include "babblekit/testcase.h"

LOG_MODULE_REGISTER(peer, LOG_LEVEL_DBG);

extern unsigned long runtime_log_level;
extern bool use_chain_adv;

/* bt_data::data_len is uint8_t (max 255), so we use multiple entries
 * sharing the same backing buffer.
 */
static uint8_t mfg_data[250];

void entrypoint_peer(void)
{
	int err;

	TEST_START("peer");

	/* Set the log level given by the `log_level` CLI argument */
	bt_testlib_log_level_set("peer", runtime_log_level);

	err = bt_enable(NULL);
	TEST_ASSERT(!err, "Bluetooth init failed (err %d)\n", err);

	LOG_DBG("Bluetooth initialised");

	struct bt_le_ext_adv *adv;

	struct bt_le_adv_param adv_param = BT_LE_ADV_PARAM_INIT(
		BT_LE_ADV_OPT_EXT_ADV, BT_GAP_ADV_FAST_INT_MIN_1, BT_GAP_ADV_FAST_INT_MAX_1, NULL);

	err = bt_le_ext_adv_create(&adv_param, NULL, &adv);
	TEST_ASSERT(!err, "Failed to create advertising set: %d", err);
	LOG_DBG("Created extended advertising set.");

	if (use_chain_adv) {
		memset(mfg_data, 0xAA, sizeof(mfg_data));

		const struct bt_data ad_chain[] = {
			BT_DATA(BT_DATA_MANUFACTURER_DATA, mfg_data, 250),
			BT_DATA(BT_DATA_MANUFACTURER_DATA, mfg_data, 250),
			BT_DATA(BT_DATA_MANUFACTURER_DATA, mfg_data, 250),
			BT_DATA(BT_DATA_MANUFACTURER_DATA, mfg_data, 250),
		};

		err = bt_le_ext_adv_set_data(adv, ad_chain, ARRAY_SIZE(ad_chain), NULL, 0);
		TEST_ASSERT(!err, "Failed to set advertising data: %d", err);
		LOG_DBG("Set chain advertising data.");
	}

	err = bt_le_ext_adv_start(adv, BT_LE_EXT_ADV_START_DEFAULT);
	TEST_ASSERT(!err, "Failed to start extended advertising: %d", err);
	LOG_DBG("Started extended advertising.");

	TEST_PASS("Tester done");
}
```
